## Kconfig
```kconfig
mainmenu "Main menu"

comment "This is a magic box with many usingful tools"

source widgets/Kconfig
```

## widgets/Kconfig
```kconfig
config TEXT_TOOL
    bool "text tools"
    default n


config PICTURE_TOOL
    bool "picture tools"
    default n
```

## widgets/widget_text/Kconfig
```kconfig
config hexdump
    bool "hexdump"
    default n

config test1
    bool "test1"
    default n

config test2
    bool "test2"
    default n
```
